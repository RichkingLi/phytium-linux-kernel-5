## drivers/crypto/te/Kconfig
```kconfig
menu "Phytium Secure Crypto Engine (SCE) Driver"
comment "Phytium Secure Crypto Engine (SCE) Driver Config"

config CRYPTO_DEV_TE
	tristate "Support for Phytium SCE enabled security processors"
	depends on OF && CRYPTO_HW
	default m
	select CRYPTO_HASH
	select CRYPTO_SKCIPHER
	select CRYPTO_LIB_DES
	select CRYPTO_AEAD
	select CRYPTO_SHA1
	select CRYPTO_MD5
	select CRYPTO_SHA256
	select CRYPTO_SHA512
	select CRYPTO_HMAC
	select CRYPTO_AES
	select CRYPTO_DES
	select CRYPTO_CBC
	select CRYPTO_ECB
	select CRYPTO_CTR
	select CRYPTO_XTS
	select CRYPTO_RSA
	select CRYPTO_ECDH
	select CRYPTO_DH
	select HW_RANDOM
	help
	  This selects the crypto driver for the Phytium SCE hardware. It supports
	  AES/SM4 with ECB, CBC, CTR, OFB and XTS modes. And for hash, it supports MD5,
	  SHA1, SHA224, SHA256, SHA384 and SHA512. it also supports GCM and CCM.
endmenu
```

## drivers/net/ethernet/phytium/Kconfig
```kconfig
#
# Phytium net device configuration
#

config NET_VENDOR_PHYTIUM
    bool "Phytium devices"
    depends on HAS_IOMEM
    default y
    help
      If you have a network (Ethernet) card belonging to this class, say Y.


if NET_VENDOR_PHYTIUM

config PHYTIUM_MACB
    tristate "Phtyium MACB/GEM support"
    depends on HAS_DMA
    select PHYLIB
    help
	  Say Y to include
	  support for the MACB/GEM chip.

	  To compile this driver as a module, choose M here: the module will be macb.

config PHYTIUM_MACB_USE_HWSTAMP
    bool "Phtyium Use IEEE 1588 hwstamp"
    depends on PHYTIUM_MACB
    default y
     imply PTP_1588_CLOCK
    help
      Enable IEEE 1588 Precision Time Protocol (PTP) support for MACB.

endif # NET_VENDOR_PHYTIUM
```

## drivers/staging/phytium-vpu/Kconfig
```kconfig
config VIDEO_PHYTIUM_VPU
	tristate "Phytium Video Processor Unit"
	depends on ARCH_PHYTIUM || COMPILE_TEST
	help
	  This driver supports the Phytium Video Processor Unit, which
	  is able to handle video decoding/encoding in a range of
	  formats.

	  To compile this driver as a module, choose M here.
```

## drivers/usb/phytium/Kconfig
```kconfig
config USB_PHYTIUM
	tristate "PHYTIUM USB Support"
	depends on USB
	help
	  Say Y or M here if your system has a OTG USB Controller based on PHYTIUM SOC.

	  If this driver is compiled as a module, it will be called phytium-usb.ko
```
